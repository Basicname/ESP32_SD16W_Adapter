## components/iray_model/Kconfig
```kconfig
menu "models: iray_model"
    config FLASH_IRAY_PICO_120_160
        bool "flash espdet_pico_120_160_inface"
        depends on !IRAY_DETECT_MODEL_IN_SDCARD
        default y

    choice
        prompt "default model"
        default IRAY_PICO_120_160
        help
            Default iray detection model
        config IRAY_PICO_120_160
            bool "espdet_pico_120_160_inface"
            depends on IRAY_DETECT_MODEL_IN_SDCARD || FLASH_IRAY_PICO_120_160
    endchoice

    config DEFAULT_IRAY_DETECT_MODEL
        int
        default 0 if IRAY_PICO_120_160

    choice
        prompt "model location"
        default IRAY_DETECT_MODEL_IN_FLASH_RODATA
        help
            iray_detect model location
        config IRAY_DETECT_MODEL_IN_FLASH_RODATA
            bool "flash_rodata"
        config IRAY_DETECT_MODEL_IN_FLASH_PARTITION
            bool "flash_partition"
        config IRAY_DETECT_MODEL_IN_SDCARD
            bool "sdcard"
    endchoice

    config IRAY_DETECT_MODEL_LOCATION
        int
        default 0 if IRAY_DETECT_MODEL_IN_FLASH_RODATA
        default 1 if IRAY_DETECT_MODEL_IN_FLASH_PARTITION
        default 2 if IRAY_DETECT_MODEL_IN_SDCARD

    config IRAY_DETECT_MODEL_SDCARD_DIR
        string "iray_detect model sdcard dir"
        default "models/s3" if IDF_TARGET_ESP32S3
        depends on IRAY_DETECT_MODEL_IN_SDCARD
        help
            Directory of models relative to sdcard mount point.
endmenu
```

## sdkconfig.defaults
```kconfig
# ESP32-S3-N16R8 (16MB Flash, 8MB OctaSRAM)
CONFIG_IDF_TARGET="esp32s3"
CONFIG_ESPTOOLPY_FLASHMODE_QIO=y
CONFIG_ESPTOOLPY_FLASHSIZE_16MB=y
CONFIG_PARTITION_TABLE_CUSTOM=y
CONFIG_PARTITION_TABLE_CUSTOM_FILENAME="partitions.csv"
CONFIG_COMPILER_OPTIMIZATION_PERF=y
CONFIG_SPIRAM=y
CONFIG_SPIRAM_MODE_OCT=y
CONFIG_SPIRAM_SPEED_80M=y
CONFIG_ESP_DEFAULT_CPU_FREQ_MHZ_240=y
CONFIG_ESP32S3_INSTRUCTION_CACHE_32KB=y
CONFIG_ESP32S3_DATA_CACHE_64KB=y
CONFIG_ESP32S3_DATA_CACHE_LINE_64B=y
CONFIG_ESP_SYSTEM_ALLOW_RTC_FAST_MEM_AS_HEAP=n
CONFIG_ESP_TASK_WDT_TIMEOUT_S=40
CONFIG_FATFS_LFN_HEAP=y
# Use flash rodata for model storage (no SD card needed)
CONFIG_IRAY_DETECT_MODEL_IN_FLASH_RODATA=y

CONFIG_HTTPD_WS_SUPPORT=y
```
